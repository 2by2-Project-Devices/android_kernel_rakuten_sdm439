/*
 * c330ae-specific persistent ram buffer.
 *
 * Keep this out of the common sdm439.dtsi so we do not affect unrelated
 * SDM439/SDM429/QM215 targets that share the same base include.
 */

&reserved_memory {
	ramoops@8ff00000 {
		compatible = "ramoops";
		reg = <0x0 0x8ff00000 0x0 0x100000>;
		record-size = <0x20000>;
		console-size = <0x40000>;
		pmsg-size = <0x20000>;
	};
};
